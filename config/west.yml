## config/west.yml
```yaml
manifest:
  defaults:
    revision: main

  remotes:
    - name: zmkfirmware
      url-base: https://github.com/zmkfirmware

    # For ZMK helper modules
    - name: urob
      url-base: https://github.com/urob

    # # For nice-view-gem
    # - name: m165437
    #   url-base: https://github.com/M165437

  projects:
    - name: zmk
      remote: zmkfirmware
      import: app/west.yml

    - name: zmk-adaptive-key # For magic key
      remote: urob

    - name: zmk-auto-layer
      remote: urob

    - name: zmk-helpers
      remote: urob

    # - name: nice-view-gem
    #   remote: m165437

  self:
    path: config
```
