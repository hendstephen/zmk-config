#define LILY58_STANDARD_LABELS
#include "includes/lily58.h"

// Define Lily58's extra keys
#define X_F &none &none &none &none &none &none    &none &none &none &none &none &none
#define X_BM &none  &none
#define X_HR &none
#define X_HL &none

#include "includes/3x6.dtsi"