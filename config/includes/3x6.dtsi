#include <behaviors.dtsi>
#include <behaviors/num_word.dtsi>
#include <dt-bindings/zmk/keys.h>
#include <dt-bindings/zmk/bt.h>
#include <dt-bindings/zmk/outputs.h>
#include <dt-bindings/zmk/ext_power.h>

// Layers
#define DEF 0
#define HND 1
#define NHT 2
#define SYM 3
#define NAV 4
#define ALT 5
#define FUN 6

#include "zmk-helpers/helper.h"
#define MAKE_HRM(NAME, HOLD, TAP, TRIGGER_POS, PRIOR_IDLE, FLAVOR) \
    ZMK_HOLD_TAP(NAME, \
        flavor = FLAVOR; \
        tapping-term-ms = <280>; \
        quick-tap-ms = <QUICK_TAP_MS>; \
        require-prior-idle-ms = <PRIOR_IDLE>; \
        bindings = <HOLD>, <TAP>; \
        hold-trigger-key-positions = <TRIGGER_POS>; \
        hold-trigger-on-release; \
    )

#define KEYS_L LT0 LT1 LT2 LT3 LT4 LT5 LM0 LM1 LM2 LM3 LM4 LM5 LB0 LB1 LB2 LB3 LB4 LB5  // left hand
#define KEYS_R RT0 RT1 RT2 RT3 RT4 RT5 RM0 RM1 RM2 RM3 RM4 RM5 RB0 RB1 RB2 RB3 RB4 RB5  // right hand
#define THUMBS LH2 LH1 LH0 RH0 RH1 RH2                                                  // thumbs

#include "unicode.dtsi"
#include "macros.dtsi"
#include "combos.dtsi" // requires layer aliases and helpers

#define XXX &none
#define ___ &trans

#define QUICK_TAP_MS 175

// Sticky-key config
&sk {  
    release-after-ms = <900>;  // release after 0.6s
    quick-release;             // no double capitalization when rolling keys
};

// Sticky-layer config
&sl {  
    ignore-modifiers;          // allow chording sticky mods & layers
};

// Layer-tap config
&lt {  
    flavor = "balanced";
    tapping-term-ms = <200>;
    quick-tap-ms = <QUICK_TAP_MS>;
};

// Mod-tap config
&mt {  
    flavor = "balanced";
    tapping-term-ms = <200>;
    quick-tap-ms = <QUICK_TAP_MS>;
};

&caps_word {  // mods deactivate caps-word, requires PR #1451
    /delete-property/ ignore-modifiers;
};

&num_word {
    continue-list = <BSPC DEL DOT COMMA PLUS MINUS STAR FSLH EQUAL COLON LBKT>;
};

/* CUSTOM KEYCODES */
#define WIN_LEFT LG(LC(LEFT))
#define WIN_RIGHT LG(LC(RIGHT))

/* Homerow mods */
// Default HRM config
MAKE_HRM(hml, &kp, &kp, KEYS_R THUMBS, 150, "balanced")  // left-hand HRMs
MAKE_HRM(hmr, &kp, &kp, KEYS_L THUMBS, 150, "balanced")  // right-hand HRMs

MAKE_HRM(hml_mo, &mo, &kp, KEYS_R THUMBS, 0, "balanced")
MAKE_HRM(hmr_mo, &mo, &kp, KEYS_L THUMBS, 0, "balanced")

// Tap-preferred HRMs for pinkies since false positives are more common
MAKE_HRM(hmlp, &kp, &kp, KEYS_R THUMBS, 150, "tap-preferred")  // left-hand HRMs
MAKE_HRM(hmrp, &kp, &kp, KEYS_L THUMBS, 150, "tap-preferred")  // right-hand HRMs

// Special HRMs for combos
MAKE_HRM(hmr_ion, &kp, &ion, KEYS_L THUMBS, 150, "tap-preferred")

/* Mod morphs */
#define SIMPLE_MORPH(NAME, MOD, BINDING1, BINDING2) \
    ZMK_MOD_MORPH(NAME, \
        mods = <(MOD_L ## MOD|MOD_R ## MOD)>; \
        bindings = <BINDING1>, <BINDING2>; \
    )

// tap: comma | shift + tap: semicolon
SIMPLE_MORPH(comma_morph, SFT, &kp COMMA, &kp SEMI)

// tap: dot | shift + tap: colon
SIMPLE_MORPH(dot_morph, SFT, &kp DOT, &kp COLON)

// tap: ' | shift + tap: "
// Technically not needed, but we add it here so it shows up in keymap svg
SIMPLE_MORPH(sqt_morph, SFT, &kp SQT, &kp DQT)

// tap: ú | hold: ü
ZMK_HOLD_TAP(ht_es_u, 
    flavor = "tap-preferred";
    tapping-term-ms = <200>;
    quick-tap-ms = <QUICK_TAP_MS>;
    bindings = <&es_u_dieresis>, <&es_u_acute>;
)
#define ES_U &ht_es_u 0 0

// tap: LC(BSPC) | ctrl + tap: BSPC
SIMPLE_MORPH(bspc_wrd, CTL, &kp LC(BSPC), &kp BSPC)

// tap: / | hold: // | shift + tap: ?
ZMK_HOLD_TAP(ht_dblslsh, 
    flavor = "tap-preferred";
    tapping-term-ms = <200>;
    quick-tap-ms = <0>;
    bindings = <&dblslsh>, <&qexcl>;
)
SIMPLE_MORPH(qexcl, SFT, &kp SLASH, &kp QMARK)
#define QEXCL &ht_dblslsh 0 0

// tap: bspc | shift + tap: del | hold: layer hold
SIMPLE_MORPH(bs_del, SFT, &kp BSPC, &kp DEL)
ZMK_HOLD_TAP(lt_bspc, 
    flavor = "balanced";
    tapping-term-ms = <200>;
    quick-tap-ms = <QUICK_TAP_MS>;
    bindings = <&mo>, <&bs_del>;
)

// tap: num-word | hold: mo layer
ZMK_HOLD_TAP(lt_num, 
    flavor = "balanced";
    tapping-term-ms = <200>;
    quick-tap-ms = <QUICK_TAP_MS>;
    bindings = <&mo>, <&num_word>;
)

// tap: sticky layer | hold: mo layer
ZMK_HOLD_TAP(lt_sl, 
    flavor = "tap-preferred";
    tapping-term-ms = <200>;
    quick-tap-ms = <QUICK_TAP_MS>;
    bindings = <&mo>, <&sl>;
)

// tap-preferred hold-tap for space on thumb
ZMK_HOLD_TAP(lt_spc, 
    flavor = "tap-preferred";
    tapping-term-ms = <200>;
    quick-tap-ms = <QUICK_TAP_MS>;
    bindings = <&mo>, <&kp>;
)

// smart shifts
SIMPLE_MORPH(smart_shftl, SFT, &sk LSHFT, &caps_word)
SIMPLE_MORPH(smart_shftr, SFT, &sk RSHFT, &caps_word)
SIMPLE_MORPH(spc_bspc, SFT, &kp SPACE, &kp BSPC)

// Adaptives
#define AK_TIMEOUT 150

ZMK_ADAPTIVE_KEY(
    magic, bindings = <&key_repeat>;
    mag_e { trigger-keys = <U M>; bindings = <&kp E>; max-prior-idle-ms = <AK_TIMEOUT>; };
    mag_oa { trigger-keys = <O>; bindings = <&kp A>; max-prior-idle-ms = <AK_TIMEOUT>; };
    mag_sft { trigger-keys = <LSHFT>; bindings = <&caps_word>; strict-modifiers; max-prior-idle-ms = <AK_TIMEOUT>; };
)

#define FUN_LEFT &lt_sl FUN ALT

/* Layers */
ZMK_LAYER(def,
//╭─────────────┬─────────────┬─────────────┬─────────────┬─────────────┬─────────────┬─────────────╮ ╭─────────────┬─────────────┬─────────────┬─────────────┬─────────────┬─────────────┬─────────────╮ 
                                                                                                    X_F
//├─────────────┼─────────────┼─────────────┼─────────────┼─────────────┼─────────────┼─────────────┤ ├─────────────┼─────────────┼─────────────┼─────────────┼─────────────┼─────────────┼─────────────┤ 
    ___           &kp Q         &kp W         &kp F         &kp P         &kp B                                       &kp J         &kp L         &kp U         &kp Y         &sqt_morph    &sk LALT
//├─────────────┼─────────────┼─────────────┼─────────────┼─────────────┼─────────────┼─────────────┤ ├─────────────┼─────────────┼─────────────┼─────────────┼─────────────┼─────────────┤─────────────┤ 
    &smart_shftl  &hmlp LALT A  &hml LCTRL R  &hml LSHFT S  &hml_mo NAV T &kp G                                       &kp M         &hmr RSHFT N  &hmr RCTRL E  &hmr RALT I   &hmrp RGUI O  &smart_shftr
//├─────────────┼─────────────┼─────────────┼─────────────┼─────────────┼─────────────┼─────────────┤ ├─────────────┼─────────────┼─────────────┼─────────────┼─────────────┼─────────────┤─────────────┤ 
    &bspc_wrd     &kp Z         &kp X         &kp C         &kp D         &kp V                     X_BM              &kp K         &kp H         &comma_morph  &dot_morph    QEXCL         &bspc_wrd
//╰─────────────┼─────────────┼─────────────┼─────────────┼─────────────┼─────────────┼─────────────┤ ├─────────────┼─────────────┼─────────────┼─────────────┼─────────────┼─────────────┤─────────────╯ 
                                                            FUN_LEFT      &smart_shftl &bs_del      &lt_spc SYM SPACE &kp RET     &lt_num FUN NAV 
//                                          ╰─────────────┼─────────────┼─────────────┼─────────────╯ ╰─────────────┼─────────────┼─────────────┼─────────────╯
)

ZMK_LAYER(dusk,
//╭─────────────┬─────────────┬─────────────┬─────────────┬─────────────┬─────────────┬─────────────╮ ╭─────────────┬─────────────┬─────────────┬─────────────┬─────────────┬─────────────┬─────────────╮ 
                                                                                                    X_F
//├─────────────┼─────────────┼─────────────┼─────────────┼─────────────┼─────────────┼─────────────┤ ├─────────────┼─────────────┼─────────────┼─────────────┼─────────────┼─────────────┼─────────────┤ 
    &kp GRAVE     &kp X         &kp F         &hml LGUI D   &kp W         &kp P                                       &kp J         &magic        &kp O         &kp U         &kp COMMA     &sk LALT
//├─────────────┼─────────────┼─────────────┼─────────────┼─────────────┼─────────────┼─────────────┤ ├─────────────┼─────────────┼─────────────┼─────────────┼─────────────┼─────────────┤─────────────┤ 
    &smart_shftl  &hmlp LALT N  &hml LCTRL S  &hml LSHFT T  &hml_mo NAV C &kp Y                                       &kp M         &hmr RSHFT H  &hmr RCTRL A  &hmr RALT E   &hmrp RGUI I  &smart_shftr
//├─────────────┼─────────────┼─────────────┼─────────────┼─────────────┼─────────────┼─────────────┤ ├─────────────┼─────────────┼─────────────┼─────────────┼─────────────┼─────────────┤─────────────┤ 
    &bspc_wrd     &kp B         &kp V         &kp K         &kp G         &kp Q                                       &kp Z         &kp L         &kp SQT       &kp SLASH     &kp DOT       &bspc_wrd
//╰─────────────┼─────────────┼─────────────┼─────────────┼─────────────┼─────────────┼─────────────┤ ├─────────────┼─────────────┼─────────────┼─────────────┼─────────────┼─────────────┤─────────────╯ 
                                                            &mo FUN       &kp RET       &lt SYM R       &spc_bspc     &kp BSPC       &mo FUN
//                                          ╰─────────────┼─────────────┼─────────────┼─────────────╯ ╰─────────────┼─────────────┼─────────────┼─────────────╯
)

ZMK_LAYER(gallium,
//╭─────────────┬─────────────┬─────────────┬─────────────┬─────────────┬─────────────┬─────────────╮ ╭─────────────┬─────────────┬─────────────┬─────────────┬─────────────┬─────────────┬─────────────╮ 
                                                                                                    X_F
//├─────────────┼─────────────┼─────────────┼─────────────┼─────────────┼─────────────┼─────────────┤ ├─────────────┼─────────────┼─────────────┼─────────────┼─────────────┼─────────────┼─────────────┤ 
    &kp GRAVE     &kp B         &kp L         &hml LGUI D   &kp W         &kp V                                       &kp J         &kp F         &kp O         &kp U         &kp COMMA     &sk LALT
//├─────────────┼─────────────┼─────────────┼─────────────┼─────────────┼─────────────┼─────────────┤ ├─────────────┼─────────────┼─────────────┼─────────────┼─────────────┼─────────────┤─────────────┤ 
    &smart_shftl  &hmlp LALT N  &hml LCTRL R  &hml LSHFT T  &hml_mo NAV S &kp G                                       &kp Y         &hmr RSHFT H  &hmr RCTRL A  &hmr RALT E   &hmrp RGUI I  &smart_shftr
//├─────────────┼─────────────┼─────────────┼─────────────┼─────────────┼─────────────┼─────────────┤ ├─────────────┼─────────────┼─────────────┼─────────────┼─────────────┼─────────────┤─────────────┤ 
    &bspc_wrd     &kp X         &kp Q         &kp M         &kp C         &kp Z                                       &kp K         &kp P         &kp SQT       &kp SLASH     &kp DOT       &bspc_wrd
//╰─────────────┼─────────────┼─────────────┼─────────────┼─────────────┼─────────────┼─────────────┤ ├─────────────┼─────────────┼─────────────┼─────────────┼─────────────┼─────────────┤─────────────╯ 
                                                            ___           ___           ___             ___           ___           ___
//                                          ╰─────────────┼─────────────┼─────────────┼─────────────╯ ╰─────────────┼─────────────┼─────────────┼─────────────╯
)

ZMK_LAYER(sym,
//╭─────────────┬─────────────┬─────────────┬─────────────┬─────────────┬─────────────┬─────────────╮ ╭─────────────┬─────────────┬─────────────┬─────────────┬─────────────┬─────────────┬─────────────╮ 
                                                                                                    X_F
//├─────────────┼─────────────┼─────────────┼─────────────┼─────────────┼─────────────┼─────────────┤ ├─────────────├─────────────┼─────────────┼─────────────┼─────────────┼─────────────┼─────────────┤ 
    ___           ___           &kp LT        &kp GT        &kp AT        &kp UNDER                                   &kp PIPE      &kp MINUS     &kp LBKT      &kp RBKT      &kp GRAVE     ___    
//├─────────────┼─────────────┼─────────────┼─────────────┼─────────────┼─────────────┼─────────────┤ ├─────────────┼─────────────┼─────────────┼─────────────┼─────────────┼─────────────┼─────────────┤ 
    ___      &hmlp LGUI EXCL &hml LALT MINUS &hml LCTRL PLUS &hml LSHFT EQUAL &kp HASH                                &kp AMPS  &hmr RSHFT COLON &hmr RCTRL LPAR &hmr RALT RPAR &hmrp RGUI SEMI   ___    
//├─────────────┼─────────────┼─────────────┼─────────────┼─────────────┼─────────────┼─────────────┤ ├─────────────┼─────────────┼─────────────┼─────────────┼─────────────┼─────────────┼─────────────┤ 
    ___           &kp BSLH      &kp SLASH     &kp STAR      &kp CARET     &kp PRCNT                 X_BM              &kp TILDE     &kp DLLR      &kp LBRC     &kp RBRC       ___           ___          
//╰─────────────┼─────────────┼─────────────┼─────────────┼─────────────┼─────────────┼─────────────┤ ├─────────────┼─────────────┼─────────────┼─────────────┼─────────────┼─────────────┤─────────────╯ 
                                                            ___           ___         &lt NAV SPACE     ___           ___           ___
//                                          ╰─────────────┼─────────────┼─────────────┼─────────────╯ ╰─────────────┼─────────────┼─────────────┼─────────────╯
)

ZMK_LAYER(nav, 
//╭─────────────┬─────────────┬─────────────┬─────────────┬─────────────┬─────────────┬─────────────╮ ╭─────────────┬─────────────┬─────────────┬─────────────┬─────────────┬─────────────┬─────────────╮ 
                                                                                                    X_F
//├─────────────┼─────────────┼─────────────┼─────────────┼─────────────┼─────────────┼─────────────┤ ├─────────────┼─────────────┼─────────────┼─────────────┼─────────────┼─────────────┼─────────────┤ 
    &kp COLON     &kp SLASH     &kp N7        &kp N8        &kp N9        &kp STAR                                    ___           &kp WIN_LEFT  &kp LS(TAB)   &kp TAB       &kp WIN_RIGHT  ___  
//├─────────────┼─────────────┼─────────────┼─────────────┼─────────────┼─────────────┼─────────────┤ ├─────────────┼─────────────┼─────────────┼─────────────┼─────────────┼─────────────┤─────────────┤ 
    &kp DOT     &hmlp LALT MINUS &hml LCTRL N4 &hml LSHFT N5 &kp N6       &kp PLUS                                   &kp PG_UP  &hmr RSHFT LEFT &hmr RCTRL DOWN &hmr RALT UP  &hmrp RGUI RIGHT ___  
//├─────────────┼─────────────┼─────────────┼─────────────┼─────────────┼─────────────┼─────────────┤ ├─────────────┼─────────────┼─────────────┼─────────────┼─────────────┼─────────────┤─────────────┤ 
    ___           &kp N0        &kp N1        &kp N2        &kp N3        &kp EQUAL                 X_BM              &kp PG_DN     &kp HOME      &kp PG_DN     &kp PG_UP     &kp END       ___  
//╰─────────────┼─────────────┼─────────────┼─────────────┼─────────────┼─────────────┼─────────────┤ ├─────────────┼─────────────┼─────────────┼─────────────┼─────────────┼─────────────┤─────────────╯ 
                                              X_HL          ___           ___           ___             ___           ___           ___           X_HR
//                                          ╰─────────────┼─────────────┼─────────────┼─────────────╯ ╰─────────────┼─────────────┼─────────────┼─────────────╯
)

ZMK_LAYER(alt,
//╭─────────────┬─────────────┬─────────────┬─────────────┬─────────────┬─────────────┬─────────────╮ ╭─────────────┬─────────────┬─────────────┬─────────────┬─────────────┬─────────────┬─────────────╮ 
                                                                                                    X_F
//├─────────────┼─────────────┼─────────────┼─────────────┼─────────────┼─────────────┼─────────────┤ ├─────────────┼─────────────┼─────────────┼─────────────┼─────────────┼─────────────┼─────────────┤ 
    ___           ___           ___           ___           ___           ___                                         ___           ___           ES_U          ___           ___           ___           
//├─────────────┼─────────────┼─────────────┼─────────────┼─────────────┼─────────────┼─────────────┤ ├─────────────┼─────────────┼─────────────┼─────────────┼─────────────┼─────────────┤─────────────┤ 
    ___           &es_a_acute   ___           ___           ___           ___                                         ___           &es_n_tilde   &es_e_acute   &es_i_acute   &es_o_acute   ___
//├─────────────┼─────────────┼─────────────┼─────────────┼─────────────┼─────────────┼─────────────┤ ├─────────────┼─────────────┼─────────────┼─────────────┼─────────────┼─────────────┤─────────────┤ 
    ___           ___           ___           ___           ___           ___                       X_BM              ___           ___           ___           &es_inv_excl  &es_inv_qmark ___           
//╰─────────────┼─────────────┼─────────────┼─────────────┼─────────────┼─────────────┼─────────────┤ ├─────────────┼─────────────┼─────────────┼─────────────┼─────────────┼─────────────┤─────────────╯ 
                                              X_HL          ___           ___           ___             ___           ___           ___           X_HR
//                                          ╰─────────────┼─────────────┼─────────────┼─────────────╯ ╰─────────────┼─────────────┼─────────────┼─────────────╯
)

ZMK_LAYER(fun,
//╭─────────────┬─────────────┬─────────────┬─────────────┬─────────────┬─────────────┬─────────────╮ ╭─────────────┬─────────────┬─────────────┬─────────────┬─────────────┬─────────────┬─────────────╮ 
                                                                                                    X_F
//├─────────────┼─────────────┼─────────────┼─────────────┼─────────────┼─────────────┼─────────────┤ ├─────────────┼─────────────┼─────────────┼─────────────┼─────────────┼─────────────┼─────────────┤ 
    &bt BT_CLR    &bt BT_SEL 0  &bt BT_SEL 1  &bt BT_SEL 2  &bt BT_SEL 3  &bt BT_SEL 4                                &out OUT_USB  &out OUT_BLE  ___           &tog NHT      &tog HND      &soft_off
//├─────────────┼─────────────┼─────────────┼─────────────┼─────────────┼─────────────┼─────────────┤ ├─────────────┼─────────────┼─────────────┼─────────────┼─────────────┼─────────────┼─────────────┤ 
    &kp F1        &kp F2        &kp F3        &kp F4        &kp F5        &kp F6                                      &kp F7        &kp F8        &kp F9        &kp F10       &kp F11       &kp F12  
//├─────────────┼─────────────┼─────────────┼─────────────┼─────────────┼─────────────┼─────────────┤ ├─────────────┼─────────────┼─────────────┼─────────────┼─────────────┼─────────────┼─────────────┤ 
    &sys_reset    &bootloader   &kp C_VOL_DN  &kp C_MUTE    &kp C_VOL_UP  ___                       X_BM              ___           &kp C_PREV    &kp C_PP     &kp C_NEXT     &bootloader   &sys_reset
//╰─────────────┼─────────────┼─────────────┼─────────────┼─────────────┼─────────────┼─────────────┤ ├─────────────┼─────────────┼─────────────┼─────────────┼─────────────┼─────────────┼─────────────╯ 
                                              X_HL          ___           ___           ___             ___           ___           ___           X_HR
//                                          ╰─────────────┼─────────────┼─────────────┼─────────────╯ ╰─────────────┼─────────────┼─────────────┼─────────────╯
)
